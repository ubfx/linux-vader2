## build/conf/bblayers.conf
```bitbake
# POKY_BBLAYERS_CONF_VERSION is increased each time build/conf/bblayers.conf
# changes incompatibly
POKY_BBLAYERS_CONF_VERSION = "2"

BBPATH = "${TOPDIR}"
BBFILES ?= ""

BBLAYERS ?= " \
  ${TOPDIR}/../poky/meta \
  ${TOPDIR}/../meta-xilinx/meta-xilinx-bsp \
  ${TOPDIR}/../meta-xilinx/meta-xilinx-standalone \
  ${TOPDIR}/../meta-openembedded/meta-oe \
  ${TOPDIR}/../meta-openembedded/meta-filesystems \
  ${TOPDIR}/../meta-openembedded/meta-python \
  ${TOPDIR}/../meta-xilinx-tools \
  ${TOPDIR}/../meta-vader2 \
  ${TOPDIR}/../meta-clang \
  "
```
